#include "bsp.h"
#include "bsp_gpio.h"
#include "bsp_uart.h"
#include "bsp_lcd.h"
#include "bsp_fft_f32.h"

char     guart1_TxMsg[UART_BUF_SIZE];
char     guart1_RxMsg[UART_BUF_SIZE];
uint16_t glcd_TxBuf[LCD_BUF_SIZE];

// 1.5 + 1.2*cos(1/32*pi*n) + 0.2*cos(15/32*pi*n + pi/4) + randn(-30dB)
float32_t fft_src[FFT_CALC_SIZE] = {
	2.855944, 2.616876, 2.449638, 2.765895, 2.802041, 2.464928, 2.289895, 2.456470,
	2.645179, 2.355677, 1.934067, 2.089591, 2.163589, 1.940918, 1.587119, 1.485206,
	1.638068, 1.577218, 1.192835, 1.013552, 1.135453, 1.093098, 0.813670, 0.583723,
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	2.351579, 2.240459, 2.461491, 2.824979, 2.653681, 2.421860, 2.535019, 2.819293,
};

float32_t fft_dst[FFT_CALC_SIZE << 1];

BSP_UART_HandleTypeDef buart = {
	.huart  = &huart1,
	.pTxMsg = guart1_TxMsg,
	.pRxMsg = guart1_RxMsg,
};

LCD_HandleTypeDef blcd = {
	.Instance = &LCD_1_80_inch,
	.hspi     = &hspi4,
	.dir      = LCD_DIR_RIGHT,
	.TxBuf    = glcd_TxBuf,
};

static void PeriodicProcess(void);

void MainProcess(void)
{
	/* Note: This project is overclocked to 200 MHz automatically. */
	
	LCD_Init(&blcd, &LCD_Font_1608, NULL, WHITE, BLACK);
	LCD_Print(&blcd, 0, 16 * 0, "FFT f32");
	
	SET_BIT(CoreDebug->DEMCR, CoreDebug_DEMCR_TRCENA_Msk);
	CLEAR_REG(DWT->CYCCNT);                       __DSB();
	SET_BIT(DWT->CTRL, DWT_CTRL_CYCCNTENA_Msk);   __DSB();
	
	// Size = 5244 bytes, Time = 83405 ticks
	BSP_FFT_f32(fft_src, fft_dst);
	
	__DSB(); CLEAR_BIT(DWT->CTRL, DWT_CTRL_CYCCNTENA_Msk);
	LCD_Print(&blcd, 0, 16 * 1, "CYCCNT: %u", DWT->CYCCNT);
	
	for (uint16_t i = 0; i < FFT_CALC_SIZE / 2; ++i)
		BSP_UART_Transmit_DMA(&buart, "[%03u]: %7.5f, %7.5f\n", i, fft_dst[i * 2], fft_dst[i * 2 + 1]);
	
	BSP_UART_ReceiveToIdle_DMA(&buart);
	HAL_TIM_Base_Start_IT(&htim17);
	
	while (1)
	{
		
	}
}

static void PeriodicProcess(void)
{
	uint8_t keyStatus = KEY_Read();
	
	static uint32_t timeCnt = 0;
	if (++timeCnt < 10) return;
	timeCnt = 0;
	
	LED_TG(R);
}

void HAL_UARTEx_RxEventCallback(UART_HandleTypeDef *huart, uint16_t Size)
{
	if (huart == buart.huart)
	{
		BSP_UART_Transmit_DMA(&buart, "RxLen: %u, RxMsg: %s", Size, buart.pRxMsg);
		BSP_UART_ReceiveToIdle_DMA(&buart);
	}
}

void HAL_TIM_PeriodElapsedCallback(TIM_HandleTypeDef *htim)
{
	if (htim == &htim17)
	{
		PeriodicProcess();
	}
}
