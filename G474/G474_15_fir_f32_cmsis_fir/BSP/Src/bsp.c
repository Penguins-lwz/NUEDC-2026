#include "bsp.h"
#include "bsp_gpio.h"
#include "bsp_uart.h"
#include "bsp_lcd.h"
#include "bsp_fir_f32.h"

char     guart1_TxMsg[UART_BUF_SIZE];
char     guart1_RxMsg[UART_BUF_SIZE];
uint16_t glcd_TxBuf[LCD_BUF_SIZE];

// 150 + 120*sin(1/24*pi*n) + 20*sin(15/24*pi*n) + randn(-20dB)
float32_t fir_src[FIR_SRC_SIZE] = {
	154.4367, 130.9922, 114.4442, 118.8462,  72.6304,  73.8115,
	 75.7114,  39.1473,  75.6053,  80.4650,   8.8077,  48.4167,
	 55.9859,  22.8526,  25.8447,  55.9207,  45.0525,  48.6128,
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	223.6005, 225.7146, 237.6725, 190.2468, 161.2194, 178.7642,
};

const float32_t fir_ref[48] = {
	150.0000, 165.6631, 181.0583, 195.9220, 210.0000, 223.0514,
	234.8528, 245.2024, 253.9230, 260.8655, 265.9111, 268.9734,
	270.0000, 268.9734, 265.9111, 260.8655, 253.9230, 245.2024,
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	 65.1472,  76.9486,  90.0000, 104.0780, 118.9417, 134.3369,
};

float32_t fir_dst[FIR_SRC_SIZE];

BSP_UART_HandleTypeDef buart = {
	.huart  = &huart1,
	.pTxMsg = guart1_TxMsg,
	.pRxMsg = guart1_RxMsg,
};

LCD_HandleTypeDef blcd = {
	.Instance = &LCD_1_80_inch,
	.hspi     = &hspi4,
	.dir      = LCD_DIR_RIGHT,
	.TxBuf    = glcd_TxBuf,
};

static void PeriodicProcess(void);

void MainProcess(void)
{
	/* Note: This project is overclocked to 200 MHz automatically. */
	
	LCD_Init(&blcd, &LCD_Font_1608, NULL, WHITE, BLACK);
	LCD_Print(&blcd, 0, 16 * 0, "FIR f32");
	
	SET_BIT(CoreDebug->DEMCR, CoreDebug_DEMCR_TRCENA_Msk);
	CLEAR_REG(DWT->CYCCNT);                       __DSB();
	SET_BIT(DWT->CTRL, DWT_CTRL_CYCCNTENA_Msk);   __DSB();
	
	// Size = 1180 bytes, Time = 121998 ticks
	BSP_FIR_f32(fir_src, fir_dst);
	
	__DSB(); CLEAR_BIT(DWT->CTRL, DWT_CTRL_CYCCNTENA_Msk);
	LCD_Print(&blcd, 0, 16 * 1, "CYCCNT: %u", DWT->CYCCNT);
	
	for (uint16_t i = 0; i < FIR_DST_SIZE; ++i)
		BSP_UART_Transmit_DMA(&buart, "[%03u]: %7.3f, %7.3f, %7.3f\n", i, fir_src[i + FIR_PAIRS], fir_dst[i + FIR_TAP_SIZE - 1], fir_ref[i % 48]);
	
	BSP_UART_ReceiveToIdle_DMA(&buart);
	HAL_TIM_Base_Start_IT(&htim17);
	
	while (1)
	{
		
	}
}

static void PeriodicProcess(void)
{
	uint8_t keyStatus = KEY_Read();
	
	static uint32_t timeCnt = 0;
	if (++timeCnt < 10) return;
	timeCnt = 0;
	
	LED_TG(R);
}

void HAL_UARTEx_RxEventCallback(UART_HandleTypeDef *huart, uint16_t Size)
{
	if (huart == buart.huart)
	{
		BSP_UART_Transmit_DMA(&buart, "RxLen: %u, RxMsg: %s", Size, buart.pRxMsg);
		BSP_UART_ReceiveToIdle_DMA(&buart);
	}
}

void HAL_TIM_PeriodElapsedCallback(TIM_HandleTypeDef *htim)
{
	if (htim == &htim17)
	{
		PeriodicProcess();
	}
}
