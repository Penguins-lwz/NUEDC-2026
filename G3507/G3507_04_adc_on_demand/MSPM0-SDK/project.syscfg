/**
 * @cliArgs --board "/ti/boards/LP_MSPM0G3507" --product "mspm0_sdk@2.10.00.04"
 * @versions {"tool":"1.27.0+4565"}
 */

/**
 * Import the modules used in this configuration.
 */
const ADC12  = scripting.addModule("/ti/driverlib/ADC12", {}, false);
const ADC121 = ADC12.addInstance();
const Board  = scripting.addModule("/ti/driverlib/Board");
const GPIO   = scripting.addModule("/ti/driverlib/GPIO", {}, false);
const GPIO1  = GPIO.addInstance();
const GPIO2  = GPIO.addInstance();
const GPIO3  = GPIO.addInstance();
const SYSCTL = scripting.addModule("/ti/driverlib/SYSCTL");
const TIMER  = scripting.addModule("/ti/driverlib/TIMER", {}, false);
const TIMER1 = TIMER.addInstance();
const UART   = scripting.addModule("/ti/driverlib/UART", {}, false);
const UART1  = UART.addInstance();

/**
 * Write custom configuration values to the imported modules.
 */
const divider9       = system.clockTree["UDIV"];
divider9.divideValue = 2;

const multiplier2         = system.clockTree["PLL_QDIV"];
multiplier2.multiplyValue = 4;

const mux4       = system.clockTree["EXHFMUX"];
mux4.inputSelect = "EXHFMUX_XTAL";

const mux8       = system.clockTree["HSCLKMUX"];
mux8.inputSelect = "HSCLKMUX_SYSPLL0";

const mux12       = system.clockTree["SYSPLLMUX"];
mux12.inputSelect = "zSYSPLLMUX_HFCLK";

const pinFunction4                        = system.clockTree["HFXT"];
pinFunction4.inputFreq                    = 40;
pinFunction4.enable                       = true;
pinFunction4.HFXTStartup                  = 8;
pinFunction4.HFCLKMonitor                 = true;
pinFunction4.peripheral.$assign           = "SYSCTL";
pinFunction4.peripheral.hfxInPin.$assign  = "j17_expansion.4";
pinFunction4.peripheral.hfxOutPin.$assign = "j17_expansion.5";

ADC121.$name                      = "ADC_0";
ADC121.sampClkSrc                 = "DL_ADC12_CLOCK_ULPCLK";
ADC121.repeatMode                 = true;
ADC121.powerDownMode              = "DL_ADC12_POWER_DOWN_MODE_MANUAL";
ADC121.peripheral.$assign         = "ADC0";
ADC121.peripheral.adcPin0.$assign = "boosterpack.8";
ADC121.adcPin0Config.$name        = "ti_driverlib_gpio_GPIOPinGeneric2";

Board.peripheral.$assign          = "DEBUGSS";
Board.peripheral.swclkPin.$assign = "j25_expansion.16";
Board.peripheral.swdioPin.$assign = "j25_expansion.14";

GPIO1.$name                               = "LED";
GPIO1.associatedPins.create(3);
GPIO1.associatedPins[0].$name             = "R";
GPIO1.associatedPins[0].launchPadShortcut = "LED2RedEn";
GPIO1.associatedPins[0].pin.$assign       = "j19_expansion.8";
GPIO1.associatedPins[1].$name             = "G";
GPIO1.associatedPins[1].launchPadShortcut = "LED2GreenEn";
GPIO1.associatedPins[1].pin.$assign       = "j19_expansion.10";
GPIO1.associatedPins[2].$name             = "B";
GPIO1.associatedPins[2].launchPadShortcut = "LED2BlueEn";
GPIO1.associatedPins[2].pin.$assign       = "j19_expansion.5";

GPIO2.$name                               = "KEY";
GPIO2.associatedPins.create(2);
GPIO2.associatedPins[0].$name             = "S1";
GPIO2.associatedPins[0].launchPadShortcut = "Button2En";
GPIO2.associatedPins[0].internalResistor  = "NONE";
GPIO2.associatedPins[0].pin.$assign       = "boosterpack.26";
GPIO2.associatedPins[1].$name             = "S2";
GPIO2.associatedPins[1].launchPadShortcut = "Button3En";
GPIO2.associatedPins[1].pin.$assign       = "j19_expansion.4";

GPIO3.$name                          = "LCD";
GPIO3.associatedPins.create(5);
GPIO3.associatedPins[0].$name        = "SCL";
GPIO3.associatedPins[0].pin.$assign  = "boosterpack.11";
GPIO3.associatedPins[1].$name        = "SDA";
GPIO3.associatedPins[1].pin.$assign  = "boosterpack.12";
GPIO3.associatedPins[2].$name        = "RST";
GPIO3.associatedPins[2].pin.$assign  = "boosterpack.13";
GPIO3.associatedPins[3].$name        = "DC";
GPIO3.associatedPins[3].initialValue = "SET";
GPIO3.associatedPins[3].pin.$assign  = "boosterpack.14";
GPIO3.associatedPins[4].$name        = "CS";
GPIO3.associatedPins[4].initialValue = "SET";
GPIO3.associatedPins[4].pin.$assign  = "boosterpack.15";

SYSCTL.clockTreeEn = true;

TIMER1.$name              = "TIMG_0";
TIMER1.timerClkPrescale   = 40;
TIMER1.timerMode          = "PERIODIC_UP";
TIMER1.timerPeriod        = "10 ms";
TIMER1.interrupts         = ["ZERO"];
TIMER1.interruptPriority  = "1";
TIMER1.peripheral.$assign = "TIMG0";

UART1.$name                             = "UART_0";
UART1.targetBaudRate                    = 115200;
UART1.enabledInterrupts                 = ["EOT_DONE","RX"];
UART1.enabledDMATXTriggers              = "DL_UART_DMA_INTERRUPT_TX";
UART1.peripheral.$assign                = "UART0";
UART1.peripheral.rxPin.$assign          = "boosterpack.33";
UART1.peripheral.txPin.$assign          = "boosterpack.34";
UART1.txPinConfig.$name                 = "ti_driverlib_gpio_GPIOPinGeneric0";
UART1.rxPinConfig.$name                 = "ti_driverlib_gpio_GPIOPinGeneric1";
UART1.DMA_CHANNEL_TX.$name              = "DMA_CH0";
UART1.DMA_CHANNEL_TX.addressMode        = "b2f";
UART1.DMA_CHANNEL_TX.srcLength          = "BYTE";
UART1.DMA_CHANNEL_TX.dstLength          = "BYTE";
UART1.DMA_CHANNEL_TX.peripheral.$assign = "DMA_CH0";
